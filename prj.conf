## CMakeLists.txt
```
cmake_minimum_required(VERSION 3.20.0)

# Pull commander before Zephyr initializes — download ONLY (don't process commander's own
# Pico CMakeLists). SOURCE_SUBDIR=include has no CMakeLists.txt, so MakeAvailable populates
# the source but skips add_subdirectory (the non-deprecated way to do FetchContent_Populate).
# GIT_TAG pins a commander release — move it with `cmdr pin <tag>`.
include(FetchContent)
FetchContent_Declare(commander GIT_REPOSITORY https://github.com/gbryant/commander.git GIT_TAG v1.1 SOURCE_SUBDIR include)
add_compile_definitions(MAX_COMMANDS=8)
FetchContent_MakeAvailable(commander)
set(COMMANDER ${commander_SOURCE_DIR})

find_package(Zephyr REQUIRED HINTS $ENV{ZEPHYR_BASE})
project(cmdr-unoq-ir-speaker)

# The Uno Q's two brains talk over the multiplexed channel bus (ch0 console + pub/sub),
# not a plain UART console. The runner switches transport on this flag.
add_compile_definitions(COMMANDER_ENABLE_CHANNELS)

target_include_directories(app PRIVATE ${COMMANDER} ${COMMANDER}/include)
target_sources(app PRIVATE
    src/main.cpp
    ${COMMANDER}/runners/zephyr/runner.cpp
    ${COMMANDER}/core/CommandRegistry.cpp
    ${COMMANDER}/transport/channels/ChannelBusRunner.cpp
    ${COMMANDER}/platform/zephyr/ZephyrIRModule.cpp   # dead-stripped unless `ir` is enabled
    ${COMMANDER}/hal/zephyr/hal.cpp
)
```

## prj.conf
```kconfig
# commander on Zephyr — Uno Q (STM32U585 / M33)
CONFIG_CPP=y
CONFIG_STD_CPP17=y
CONFIG_CPP_EXCEPTIONS=n

CONFIG_SERIAL=y
CONFIG_CONSOLE=y
CONFIG_UART_CONSOLE=y
CONFIG_UART_INTERRUPT_DRIVEN=y     # RX must be ISR-driven (poll overruns at 115200)
CONFIG_GPIO=y                      # IR edge capture

CONFIG_NEWLIB_LIBC=y               # commander uses snprintf etc.
CONFIG_MAIN_STACK_SIZE=2048
```

## app.overlay
```dts
/* Route commander's console to lpuart1 = the QRB bridge UART (-> /dev/ttyHS1).
 * The board default (usart1) is the Arduino header Serial1 (D0/D1), not the Linux side. */
/ {
    chosen {
        zephyr,console = &lpuart1;
        zephyr,shell-uart = &lpuart1;
    };

    /* IR receiver OUT pin — used only when the `ir` module is enabled. Default D5
     * (arduino_header index 11 = &gpioa 11). Edit to move the pin. */
    zephyr,user {
        ir-gpios = <&arduino_header 11 GPIO_ACTIVE_HIGH>;
    };
};
```

## src/main.cpp
```c
#include "commander.h"
#include "commander_modules.h"   // generated by cmdr — run `cmdr module`

extern "C" CommanderConfig commander_config() {
    CommanderConfig cfg;
    cfg.uart_baud     = 115200;
    cfg.uart_greeting = "cmdr-unoq-ir-speaker";
    return cfg;
}

extern "C" void commander_setup(CommandRegistry& reg) {
    commander_register_modules(reg);
}
```

## src/commander_modules.h
```c
// AUTO-GENERATED by cmdr — do not edit.
// Manage modules with: cmdr module enable|disable|list
#pragma once
#include "core/CommandRegistry.h"
#include "core/SystemModule.h"
#include "channel_ids.h"
#include "platform/zephyr/ZephyrIRModule.h"
#include "transport/channels/ChannelBusRunner.h"
#include "core/NullWriter.h"

static SystemModule _m_system;
static ZephyrIRModule _m_ir;
static ChannelTransport::ChannelPublisher _pub_ir;

inline void commander_register_modules(CommandRegistry &reg) {
    reg.registerModule(_m_system);
    reg.registerModule(_m_ir);
}

extern "C" void commander_on_channel_bus_ready(ChannelBusRunner &bus) {
    _pub_ir = bus.channels().publisher(CH_IR);
    _m_ir.setOutput(&_pub_ir);
    bus.addTicker(_m_ir);
}

extern "C" void commander_run_autostart(CommandRegistry &reg) {
    NullWriter _null;
    reg.dispatch("ir recv", _null);
}
```
